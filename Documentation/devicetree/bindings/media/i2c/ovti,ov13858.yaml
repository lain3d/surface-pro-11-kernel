## Documentation/devicetree/bindings/media/i2c/ovti,ov13858.yaml
```yaml
# SPDX-License-Identifier: (GPL-2.0 OR BSD-2-Clause)
%YAML 1.2
---
$id: http://devicetree.org/schemas/media/i2c/ovti,ov13858.yaml#
$schema: http://devicetree.org/meta-schemas/core.yaml#

title: Omnivision OV13858 CMOS Sensor

maintainers:
  - Sakari Ailus <sakari.ailus@linux.intel.com>

description:
  The Omnivision OV13858 is a 13 megapixel CMOS image sensor with a 4-lane
  MIPI CSI-2 interface, supporting 4224x3136 at 1080 Mbps/lane and a binned
  2112x1568 mode at 540 Mbps/lane. It requires a 19.2 MHz external clock.

allOf:
  - $ref: /schemas/media/video-interface-devices.yaml#

properties:
  compatible:
    const: ovti,ov13858

  reg:
    maxItems: 1

  clocks:
    maxItems: 1
    description: External clock (XVCLK), 19.2 MHz.

  avdd-supply:
    description: Analogue circuit voltage supply.

  dovdd-supply:
    description: I/O circuit voltage supply.

  dvdd-supply:
    description: Digital circuit voltage supply.

  reset-gpios:
    description: Active low GPIO connected to the XSHUTDOWN pad of the sensor.

  port:
    $ref: /schemas/graph.yaml#/$defs/port-base
    additionalProperties: false

    properties:
      endpoint:
        $ref: /schemas/media/video-interfaces.yaml#
        additionalProperties: false

        properties:
          data-lanes:
            items:
              - const: 1
              - const: 2
              - const: 3
              - const: 4
          link-frequencies: true
          remote-endpoint: true

        required:
          - data-lanes
          - link-frequencies
          - remote-endpoint

required:
  - compatible
  - reg
  - clocks
  - port

unevaluatedProperties: false

examples:
  - |
    #include <dt-bindings/gpio/gpio.h>

    i2c {
        #address-cells = <1>;
        #size-cells = <0>;

        camera@10 {
            compatible = "ovti,ov13858";
            reg = <0x10>;

            reset-gpios = <&tlmm 110 GPIO_ACTIVE_LOW>;
            pinctrl-names = "default";
            pinctrl-0 = <&cam_rear_default>;

            clocks = <&ov13858_clk>;
            assigned-clocks = <&ov13858_clk>;
            assigned-clock-rates = <19200000>;

            avdd-supply = <&vreg_l5m_2p8>;
            dovdd-supply = <&vreg_l6m_1p8>;
            dvdd-supply = <&vreg_l1m_1p2>;

            orientation = <0>;

            port {
                ov13858_ep: endpoint {
                    remote-endpoint = <&csiphy_ep>;
                    data-lanes = <1 2 3 4>;
                    link-frequencies = /bits/ 64 <540000000 270000000>;
                };
            };
        };
    };
...
```

## Documentation/devicetree/bindings/media/i2c/sony,imx681.yaml
```yaml
# SPDX-License-Identifier: (GPL-2.0 OR BSD-2-Clause)
%YAML 1.2
---
$id: http://devicetree.org/schemas/media/i2c/sony,imx681.yaml#
$schema: http://devicetree.org/meta-schemas/core.yaml#

title: Sony IMX681 CMOS Sensor

maintainers:
  - Linux Media Mailing List <linux-media@vger.kernel.org>

description:
  The Sony IMX681 is a CMOS image sensor with a single-lane MIPI CSI-2
  interface, used as the front camera of the Microsoft Surface Pro 11 where it
  is enumerated by ACPI as SONY0681. It outputs 10-bit Bayer with a maximum
  array of 4032x3024 and requires a 19.2 MHz external clock.

allOf:
  - $ref: /schemas/media/video-interface-devices.yaml#

properties:
  compatible:
    const: sony,imx681

  reg:
    maxItems: 1

  clocks:
    maxItems: 1
    description: External clock (EXTCLK), 19.2 MHz.

  avdd-supply:
    description: Analogue circuit voltage supply.

  dovdd-supply:
    description: I/O circuit voltage supply.

  reset-gpios:
    description: Active low GPIO connected to the XCLR pad of the sensor.

  port:
    $ref: /schemas/graph.yaml#/$defs/port-base
    additionalProperties: false

    properties:
      endpoint:
        $ref: /schemas/media/video-interfaces.yaml#
        additionalProperties: false

        properties:
          data-lanes:
            items:
              - const: 1
          link-frequencies: true
          remote-endpoint: true

        required:
          - data-lanes
          - link-frequencies
          - remote-endpoint

required:
  - compatible
  - reg
  - clocks
  - port

unevaluatedProperties: false

examples:
  - |
    #include <dt-bindings/gpio/gpio.h>

    i2c {
        #address-cells = <1>;
        #size-cells = <0>;

        camera@1a {
            compatible = "sony,imx681";
            reg = <0x1a>;

            reset-gpios = <&tlmm 237 GPIO_ACTIVE_LOW>;
            pinctrl-names = "default";
            pinctrl-0 = <&cam_front_default>;

            clocks = <&imx681_clk>;
            assigned-clocks = <&imx681_clk>;
            assigned-clock-rates = <19200000>;

            avdd-supply = <&vreg_l7b_2p8>;
            dovdd-supply = <&vreg_l3m_1p8>;

            orientation = <0>;
            rotation = <0>;

            port {
                imx681_ep: endpoint {
                    remote-endpoint = <&csiphy2_ep>;
                    data-lanes = <1>;
                    link-frequencies = /bits/ 64 <998400000 1200000000>;
                };
            };
        };
    };
...
```

## Documentation/devicetree/bindings/thunderbolt/qcom,x1e80100-usb4.yaml
```yaml
# SPDX-License-Identifier: (GPL-2.0-only OR BSD-2-Clause)
%YAML 1.2
---
$id: http://devicetree.org/schemas/thunderbolt/qcom,x1e80100-usb4.yaml#
$schema: http://devicetree.org/meta-schemas/core.yaml#

title: Qualcomm X1E80100 USB4 Host Router

maintainers:
  - Linux USB Mailing List <linux-usb@vger.kernel.org>

description:
  A USB4 host router on the Qualcomm X1E80100. The register interface is the
  one the USB4 specification defines for the host interface, so the driver is
  the generic one; only the enumeration differs from a PCIe-attached router.
  Firmware describes the same blocks through ACPI as ACPI0015 devices.

properties:
  compatible:
    const: qcom,x1e80100-usb4

  reg:
    maxItems: 1

  interrupts:
    items:
      - description: host interface (NHI) interrupt
      - description: wake interrupt
      - description: misc/status interrupt

  interrupt-names:
    items:
      - const: nhi
      - const: wake
      - const: misc

  clocks:
    items:
      - description: master clock
      - description: configuration AHB clock
      - description: system clock
      - description: time management unit clock
      - description: sideband interface clock

  clock-names:
    items:
      - const: master
      - const: cfg_ahb
      - const: sys
      - const: tmu
      - const: sb_if

required:
  - compatible
  - reg
  - interrupts
  - interrupt-names
  - clocks
  - clock-names

additionalProperties: false

examples:
  - |
    #include <dt-bindings/interrupt-controller/arm-gic.h>

    soc {
        #address-cells = <2>;
        #size-cells = <2>;

        usb4@1563f000 {
            compatible = "qcom,x1e80100-usb4";
            reg = <0 0x1563f000 0 0x000c0000>;

            interrupts = <GIC_SPI 472 IRQ_TYPE_LEVEL_HIGH>,
                         <GIC_SPI 255 IRQ_TYPE_EDGE_RISING>,
                         <GIC_SPI 579 IRQ_TYPE_LEVEL_HIGH>;
            interrupt-names = "nhi",
                              "wake",
                              "misc";

            clocks = <&gcc 299>,
                     <&gcc 296>,
                     <&gcc 309>,
                     <&gcc 310>,
                     <&gcc 307>;
            clock-names = "master",
                          "cfg_ahb",
                          "sys",
                          "tmu",
                          "sb_if";
        };
    };
...
```
